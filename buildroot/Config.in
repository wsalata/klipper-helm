## buildroot/Config.in
```kconfig
source "$BR2_EXTERNAL_KLIPPER_HELM_PATH/package/klipper-helm/Config.in"
source "$BR2_EXTERNAL_KLIPPER_HELM_PATH/package/odroidxu4-blobs/Config.in"
```

## buildroot/package/klipper-helm/Config.in
```kconfig
config BR2_PACKAGE_KLIPPER_HELM
	bool "klipper-helm"
	depends on BR2_PACKAGE_HOST_RUSTC_TARGET_ARCH_SUPPORTS
	depends on BR2_PACKAGE_HAS_UDEV # libinput
	select BR2_PACKAGE_HOST_RUSTC
	select BR2_PACKAGE_LIBINPUT
	select BR2_PACKAGE_LIBXKBCOMMON
	select BR2_PACKAGE_FONTCONFIG
	help
	  Touch screen panel for Klipper/Moonraker, drawing directly
	  on the display through DRM/KMS with Slint's software renderer.
	  Started and restarted by init, see the board overlay.

comment "klipper-helm needs udev /dev management"
	depends on BR2_PACKAGE_HOST_RUSTC_TARGET_ARCH_SUPPORTS
	depends on !BR2_PACKAGE_HAS_UDEV
```

## buildroot/package/odroidxu4-blobs/Config.in
```kconfig
config BR2_PACKAGE_ODROIDXU4_BLOBS
	bool "odroidxu4-blobs"
	depends on BR2_arm
	help
	  Signed first-stage loaders (BL1, BL2) and TrustZone firmware
	  from Hardkernel. The Exynos 5422 boot ROM only runs signed code,
	  so they must sit in front of U-Boot on the SD card or eMMC.

	  https://github.com/hardkernel/u-boot
```
